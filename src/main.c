#include <zephyr/kernel.h>
#include <zephyr/device.h>
#include <zephyr/drivers/spi.h>
#include <zephyr/drivers/gpio.h>
#include <zephyr/logging/log.h>

#include "../subsys/ui_engine/include/lcd.h"
#include "../subsys/ui_engine/include/ui_engine.h"
#include "../subsys/ui_engine/include/ui_layout.h"

LOG_MODULE_REGISTER(ST7735_LAYOUT_APP, LOG_LEVEL_INF);

#define LCD_WIDTH     128
#define LCD_HEIGHT    160

// Comandos do ST7735
#define ST7735_SWRESET 0x01
#define ST7735_SLPOUT  0x11
#define ST7735_NORON   0x13
#define ST7735_DISPON  0x29
#define ST7735_CASET   0x2A
#define ST7735_RASET   0x2B
#define ST7735_RAMWR   0x2C
#define ST7735_MADCTL  0x36
#define ST7735_COLMOD  0x3A

// Cores RGB
#define COLOR_BLACK     0x0000
#define COLOR_WHITE     0xFFFF
#define COLOR_YELLOW    0x00F8
#define COLOR_RED       0x0007
#define COLOR_GREEN     0x1F00
#define COLOR_BLUE      0xE000

/* Dispositivos do Zephyr (corrigido warning de descontinuação do parâmetro delay) */
static const struct spi_dt_spec spi_spec = SPI_DT_SPEC_GET(DT_NODELABEL(st7735_dev), SPI_WORD_SET(8) | SPI_TRANSFER_MSB);
static const struct gpio_dt_spec dc_gpio = GPIO_DT_SPEC_GET(DT_ALIAS(lcd_dc), gpios);
static const struct gpio_dt_spec rst_gpio = GPIO_DT_SPEC_GET(DT_ALIAS(lcd_rst), gpios);

// Fonte Bitmap 5x7
static const uint8_t font5x7[] = {
    0x00, 0x00, 0x00, 0x00, 0x00, 0x00, 0x00, 0x5f, 0x00, 0x00, 0x00, 0x07, 0x00, 0x07, 0x00,
    0x14, 0x7f, 0x14, 0x7f, 0x14, 0x24, 0x2a, 0x7f, 0x2a, 0x12, 0x23, 0x13, 0x08, 0x64, 0x62,
    0x36, 0x49, 0x55, 0x22, 0x50, 0x00, 0x05, 0x03, 0x00, 0x00, 0x00, 0x1c, 0x22, 0x41, 0x00,
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    0x44, 0x64, 0x54, 0x4c, 0x44
};

static void lcd_cmd(uint8_t cmd) {
    gpio_pin_set_dt(&dc_gpio, 0);
    struct spi_buf buf = {.buf = &cmd, .len = 1};
    struct spi_buf_set tx = {.buffers = &buf, .count = 1};
    spi_write_dt(&spi_spec, &tx);
}

static void lcd_data(const uint8_t *data, size_t len) {
    if (len == 0) return;
    gpio_pin_set_dt(&dc_gpio, 1);
    struct spi_buf buf = {.buf = (void *)data, .len = len};
    struct spi_buf_set tx = {.buffers = &buf, .count = 1};
    spi_write_dt(&spi_spec, &tx);
}

static void st7735_init_blacktab(void) {
    gpio_pin_set_dt(&rst_gpio, 1);
    k_msleep(10);
    gpio_pin_set_dt(&rst_gpio, 0);
    k_msleep(10);
    gpio_pin_set_dt(&rst_gpio, 1);
    k_msleep(150);

    lcd_cmd(ST7735_SWRESET);
    k_msleep(150);

    lcd_cmd(ST7735_SLPOUT);
    k_msleep(500);

    lcd_cmd(ST7735_COLMOD);
    uint8_t format = 0x05;
    lcd_data(&format, 1);
    k_msleep(10);

    lcd_cmd(ST7735_MADCTL);
    uint8_t madctl = 0xC8;
    lcd_data(&madctl, 1);

    lcd_cmd(ST7735_NORON);
    k_msleep(10);

    lcd_cmd(ST7735_DISPON);
    k_msleep(100);
}


int main(void) {
    LOG_INF("Iniciando Aplicação de Layout...");

    if (ui_engine_init() != 0) {
        LOG_ERR("Erro ao inicializar UI Engine!");
        return 0;
    }

    // Instancia o layout de 3 regiões
    ui_layout_t main_layout;
    ui_layout_init_standard(&main_layout);

    // 1. PRIMEIRO: Preenche o fundo de todas as áreas
    lcd_fill_rect(main_layout.header.x, main_layout.header.y, 
                  main_layout.header.width, main_layout.header.height, COLOR_YELLOW);

    lcd_fill_rect(main_layout.content.x, main_layout.content.y, 
                  main_layout.content.width, main_layout.content.height, COLOR_BLACK);

    lcd_fill_rect(main_layout.footer.x, main_layout.footer.y, 
                  main_layout.footer.width, main_layout.footer.height, COLOR_GREEN);

    // 2. SEGUNDO: Desenha os textos sobre os fundos
    ui_draw_header(&main_layout, "SYSTEM PANEL", COLOR_WHITE, COLOR_BLUE);
    
    lcd_draw_string(10, 70, "Content Area", COLOR_WHITE, COLOR_BLACK, 1);
    lcd_draw_string(10, 85, "128x120 Pixels", COLOR_GREEN, COLOR_BLACK, 1);

    ui_draw_footer(&main_layout, "STATUS: READY", COLOR_YELLOW, COLOR_GREEN);

    LOG_INF("Layout renderizado!");

    while (1) {
        k_msleep(1000);
    }

    return 0;
}